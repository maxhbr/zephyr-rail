/*
 * Raytac AN7002-DB nRF5340 overlay
 * SPDX-License-Identifier: Apache-2.0
 */

/ {
	stepper_motor: stepper_motor {
		compatible = "simple-stepper";
		status = "okay";
		step-gpios = <&gpio0 2 GPIO_ACTIVE_HIGH>;
		dir-gpios = <&gpio0 3 GPIO_ACTIVE_HIGH>;
		en-gpios = <&gpio0 4 GPIO_ACTIVE_LOW>;
		step-width-ns = <2500>;
		micro-step-res = <256>;
	};
};
