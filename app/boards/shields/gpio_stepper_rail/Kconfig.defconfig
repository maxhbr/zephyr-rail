## app/boards/shields/gpio_stepper_rail/Kconfig.shield
```kconfig
config SHIELD_GPIO_STEPPER_RAIL
	def_bool $(shields_list_contains,gpio_stepper_rail)
```

## app/boards/xiao_esp32s3_esp32s3_procpu.conf
```kconfig
CONFIG_BT_DEVICE_NAME="ZephyrRailXesp32s3"

CONFIG_BOOT_DELAY=5000

CONFIG_HEAP_MEM_POOL_SIZE=131072

# Bluetooth buffer configuration for ESP32-S3
# Increase HCI/ACL buffer sizes to handle larger packets
CONFIG_BT_BUF_ACL_TX_SIZE=251
CONFIG_BT_BUF_ACL_RX_SIZE=251
CONFIG_BT_BUF_ACL_TX_COUNT=10
CONFIG_BT_BUF_ACL_RX_COUNT_EXTRA=9
CONFIG_BT_L2CAP_TX_BUF_COUNT=10
CONFIG_BT_L2CAP_TX_MTU=247

# Event buffer configuration
CONFIG_BT_BUF_EVT_RX_SIZE=255
CONFIG_BT_BUF_EVT_RX_COUNT=16
CONFIG_BT_BUF_EVT_DISCARDABLE_COUNT=12
CONFIG_BT_BUF_EVT_DISCARDABLE_SIZE=255

# Command buffer configuration
CONFIG_BT_BUF_CMD_TX_SIZE=255

# Additional ESP32-S3 specific settings
CONFIG_BT_RX_STACK_SIZE=2048

# Connection and pairing timeout settings
CONFIG_BT_CONN_PARAM_UPDATE_TIMEOUT=5000
```

## app/builds/wio_terminal/Kconfig/Kconfig.modules
```kconfig
menu "acpica (/home/mhuber/MINE/REPOS/zephyr-rail/modules/lib/acpica)"
osource "$(ZEPHYR_ACPICA_KCONFIG)"
config ZEPHYR_ACPICA_MODULE
	bool
	default y
endmenu
menu "canopennode (/home/mhuber/MINE/REPOS/zephyr-rail/modules/lib/canopennode)"
osource "$(ZEPHYR_CANOPENNODE_KCONFIG)"
config ZEPHYR_CANOPENNODE_MODULE
	bool
	default y
endmenu
menu "cmsis (/home/mhuber/MINE/REPOS/zephyr-rail/modules/hal/cmsis)"
osource "$(ZEPHYR_CMSIS_KCONFIG)"
config ZEPHYR_CMSIS_MODULE
	bool
	default y
endmenu
menu "cmsis-dsp (/home/mhuber/MINE/REPOS/zephyr-rail/modules/lib/cmsis-dsp)"
osource "$(ZEPHYR_CMSIS_DSP_KCONFIG)"
config ZEPHYR_CMSIS_DSP_MODULE
	bool
	default y
endmenu
menu "cmsis-nn (/home/mhuber/MINE/REPOS/zephyr-rail/modules/lib/cmsis-nn)"
osource "$(ZEPHYR_CMSIS_NN_KCONFIG)"
config ZEPHYR_CMSIS_NN_MODULE
	bool
	default y
endmenu
menu "fatfs (/home/mhuber/MINE/REPOS/zephyr-rail/modules/fs/fatfs)"
osource "$(ZEPHYR_FATFS_KCONFIG)"
config ZEPHYR_FATFS_MODULE
	bool
	default y
endmenu
menu "hal_ambiq (/home/mhuber/MINE/REPOS/zephyr-rail/modules/hal/ambiq)"
osource "$(ZEPHYR_HAL_AMBIQ_KCONFIG)"
config ZEPHYR_HAL_AMBIQ_MODULE
	bool
	default y
endmenu
menu "hal_espressif (/home/mhuber/MINE/REPOS/zephyr-rail/modules/hal/espressif)"
osource "/home/mhuber/MINE/REPOS/zephyr-rail/modules/hal/espressif/zephyr/Kconfig"
config ZEPHYR_HAL_ESPRESSIF_MODULE
	bool
	default y
	select TAINT_BLOBS
endmenu
menu "hal_ethos_u (/home/mhuber/MINE/REPOS/zephyr-rail/modules/hal/ethos_u)"
osource "$(ZEPHYR_HAL_ETHOS_U_KCONFIG)"
config ZEPHYR_HAL_ETHOS_U_MODULE
	bool
	default y
endmenu
menu "hal_gigadevice (/home/mhuber/MINE/REPOS/zephyr-rail/modules/hal/gigadevice)"
osource "$(ZEPHYR_HAL_GIGADEVICE_KCONFIG)"
config ZEPHYR_HAL_GIGADEVICE_MODULE
	bool
	default y
endmenu
menu "hal_infineon (/home/mhuber/MINE/REPOS/zephyr-rail/modules/hal/infineon)"
osource "$(ZEPHYR_HAL_INFINEON_KCONFIG)"
config ZEPHYR_HAL_INFINEON_MODULE
	bool
	default y
endmenu
menu "hal_nordic (/home/mhuber/MINE/REPOS/zephyr-rail/modules/hal/nordic)"
osource "$(ZEPHYR_HAL_NORDIC_KCONFIG)"
config ZEPHYR_HAL_NORDIC_MODULE
	bool
	default y
endmenu
menu "hal_nxp (/home/mhuber/MINE/REPOS/zephyr-rail/modules/hal/nxp)"
osource "$(ZEPHYR_HAL_NXP_KCONFIG)"
config ZEPHYR_HAL_NXP_MODULE
	bool
	default y
endmenu
menu "hal_rpi_pico (/home/mhuber/MINE/REPOS/zephyr-rail/modules/hal/rpi_pico)"
osource "$(ZEPHYR_HAL_RPI_PICO_KCONFIG)"
config ZEPHYR_HAL_RPI_PICO_MODULE
	bool
	default y
endmenu
menu "silabs (/home/mhuber/MINE/REPOS/zephyr-rail/modules/hal/silabs)"
osource "/home/mhuber/MINE/REPOS/zephyr-rail/modules/hal/silabs/zephyr/Kconfig"
config ZEPHYR_SILABS_MODULE
	bool
	default y
endmenu
menu "hal_telink (/home/mhuber/MINE/REPOS/zephyr-rail/modules/hal/telink)"
osource "/home/mhuber/MINE/REPOS/zephyr-rail/modules/hal/telink/Kconfig"
config ZEPHYR_HAL_TELINK_MODULE
	bool
	default y
endmenu
menu "liblc3 (/home/mhuber/MINE/REPOS/zephyr-rail/modules/lib/liblc3)"
osource "$(ZEPHYR_LIBLC3_KCONFIG)"
config ZEPHYR_LIBLC3_MODULE
	bool
	default y
endmenu
menu "littlefs (/home/mhuber/MINE/REPOS/zephyr-rail/modules/fs/littlefs)"
osource "$(ZEPHYR_LITTLEFS_KCONFIG)"
config ZEPHYR_LITTLEFS_MODULE
	bool
	default y
endmenu
menu "loramac-node (/home/mhuber/MINE/REPOS/zephyr-rail/modules/lib/loramac-node)"
osource "$(ZEPHYR_LORAMAC_NODE_KCONFIG)"
config ZEPHYR_LORAMAC_NODE_MODULE
	bool
	default y
endmenu
menu "lvgl (/home/mhuber/MINE/REPOS/zephyr-rail/modules/lib/gui/lvgl)"
osource "/home/mhuber/MINE/REPOS/zephyr-rail/modules/lib/gui/lvgl/Kconfig"
config ZEPHYR_LVGL_MODULE
	bool
	default y
endmenu
menu "mbedtls (/home/mhuber/MINE/REPOS/zephyr-rail/modules/crypto/mbedtls)"
osource "$(ZEPHYR_MBEDTLS_KCONFIG)"
config ZEPHYR_MBEDTLS_MODULE
	bool
	default y
endmenu
menu "openthread (/home/mhuber/MINE/REPOS/zephyr-rail/modules/lib/openthread)"
osource "$(ZEPHYR_OPENTHREAD_KCONFIG)"
config ZEPHYR_OPENTHREAD_MODULE
	bool
	default y
endmenu
menu "percepio (/home/mhuber/MINE/REPOS/zephyr-rail/modules/debug/percepio)"
osource "/home/mhuber/MINE/REPOS/zephyr-rail/modules/debug/percepio/zephyr/Kconfig"
config ZEPHYR_PERCEPIO_MODULE
	bool
	default y
endmenu
menu "picolibc (/home/mhuber/MINE/REPOS/zephyr-rail/modules/lib/picolibc)"
osource "/home/mhuber/MINE/REPOS/zephyr-rail/modules/lib/picolibc/zephyr/Kconfig"
config ZEPHYR_PICOLIBC_MODULE
	bool
	default y
endmenu
menu "segger (/home/mhuber/MINE/REPOS/zephyr-rail/modules/debug/segger)"
osource "$(ZEPHYR_SEGGER_KCONFIG)"
config ZEPHYR_SEGGER_MODULE
	bool
	default y
endmenu
menu "trusted-firmware-m (/home/mhuber/MINE/REPOS/zephyr-rail/modules/tee/tf-m/trusted-firmware-m)"
osource "$(ZEPHYR_TRUSTED_FIRMWARE_M_KCONFIG)"
config ZEPHYR_TRUSTED_FIRMWARE_M_MODULE
	bool
	default y
endmenu
menu "trusted-firmware-a (/home/mhuber/MINE/REPOS/zephyr-rail/modules/tee/tf-a/trusted-firmware-a)"
osource "$(ZEPHYR_TRUSTED_FIRMWARE_A_KCONFIG)"
config ZEPHYR_TRUSTED_FIRMWARE_A_MODULE
	bool
	default y
endmenu
menu "uoscore-uedhoc (/home/mhuber/MINE/REPOS/zephyr-rail/modules/lib/uoscore-uedhoc)"
osource "$(ZEPHYR_UOSCORE_UEDHOC_KCONFIG)"
config ZEPHYR_UOSCORE_UEDHOC_MODULE
	bool
	default y
endmenu
menu "zcbor (/home/mhuber/MINE/REPOS/zephyr-rail/modules/lib/zcbor)"
osource "$(ZEPHYR_ZCBOR_KCONFIG)"
config ZEPHYR_ZCBOR_MODULE
	bool
	default y
endmenu
```

## app/drivers/stepper/Kconfig
```kconfig
# SPDX-License-Identifier: Apache-2.0

config SIMPLE_STEPPER
	bool "Simple Step/Dir/Enable Stepper Driver"
	default y
	depends on DT_HAS_SIMPLE_STEPPER_ENABLED
	depends on GPIO
	help
	  Enable support for simple step/direction/enable stepper motor drivers.
	  This driver provides basic control using three GPIO pins: step, direction,
	  and enable.
```

## app/tests/state_machine/testcase.yaml
```yaml
tests:
  state_machine.ztest:
    platform_allow: native_sim
    tags: state_machine integration
```

## app_gui/boards/native_sim.conf
```kconfig
# # For native_sim board - Bluetooth is simulated
# CONFIG_BT_CTLR=n

# ###############################################################################
# ### bluetooth
# # Bluetooth Central with bonding & GATT client
# CONFIG_BT=y
# CONFIG_BT_CENTRAL=y
# CONFIG_BT_GATT_CLIENT=y

# # Enable pairing and bonding
# CONFIG_BT_SMP=y
# CONFIG_BT_BONDABLE=y
# CONFIG_BT_SMP_SC_PAIR_ONLY=y

# # Enable logging
# CONFIG_LOG=y

# # Console
# CONFIG_CONSOLE=y
# CONFIG_UART_CONSOLE=y

# # General settings
# CONFIG_HEAP_MEM_POOL_SIZE=16384
# CONFIG_MAIN_STACK_SIZE=4096
# CONFIG_SYSTEM_WORKQUEUE_STACK_SIZE=4096

# # Increase BT stack sizes
# CONFIG_BT_RX_STACK_SIZE=2048
# CONFIG_BT_HCI_TX_STACK_SIZE=1024

# # Enable memory protection and debugging
# CONFIG_MPU_STACK_GUARD=y
# CONFIG_THREAD_STACK_INFO=y

# # Additional BT settings for stability
# CONFIG_BT_BUF_ACL_RX_SIZE=251
# CONFIG_BT_BUF_ACL_TX_SIZE=251
# CONFIG_BT_L2CAP_TX_MTU=247
# CONFIG_BT_BUF_ACL_TX_COUNT=3
# CONFIG_BT_BUF_ACL_RX_COUNT=6

# # Persist bonds so the camera reconnects automatically
# CONFIG_SETTINGS=y
# CONFIG_BT_SETTINGS=y
```

## lib/stepper_with_target/Kconfig
```kconfig
# SPDX-License-Identifier: Apache-2.0

config STEPPER_WITH_TARGET
	bool "Stepper with Target Library"
	default y
	depends on STEPPER
	help
	  Enable the stepper with target library which provides a high-level
	  interface for controlling stepper motors with target position tracking.

if STEPPER_WITH_TARGET

rsource "drivers/Kconfig"

endif # STEPPER_WITH_TARGET
```

## lib/stepper_with_target/drivers/Kconfig
```kconfig
# SPDX-License-Identifier: Apache-2.0

menu "Device Drivers"

rsource "stepper/Kconfig"

endmenu
```
