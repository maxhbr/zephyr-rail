/*
 * GPIO Stepper Rail Shield
 * SPDX-License-Identifier: Apache-2.0
 */

/ {
	stepper_motor: stepper_motor {
		compatible = "simple-stepper";
		status = "okay";
		step-gpios = <&xiao_d 3 GPIO_ACTIVE_HIGH>;
		dir-gpios = <&xiao_d 4 GPIO_ACTIVE_HIGH>;
		en-gpios = <&xiao_d 5 GPIO_ACTIVE_LOW>;
		step-width-ns = <2500>;
		micro-step-res = <256>;
		invert-pins;
	};
};