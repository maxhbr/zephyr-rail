## CMakeLists.txt
```
cmake_minimum_required(VERSION 3.20.0)
find_package(Zephyr REQUIRED HINTS $ENV{ZEPHYR_BASE})
project(state_machine_tests)

set(APP_ROOT ${CMAKE_CURRENT_SOURCE_DIR}/../..)
set(REPO_ROOT ${APP_ROOT}/..)

set(TEST_SOURCES
    ${APP_ROOT}/src/StateMachine.cpp
    ${APP_ROOT}/src/Stack.cpp
    ${CMAKE_CURRENT_SOURCE_DIR}/src/fake_stepper_with_target.cpp
    ${REPO_ROOT}/lib/sony_remote/src/fake_sony_remote.cpp
    ${CMAKE_CURRENT_SOURCE_DIR}/src/main.cpp)

target_sources(app PRIVATE ${TEST_SOURCES})

target_include_directories(app PRIVATE
    ${APP_ROOT}/src
    ${REPO_ROOT}/lib/stepper_with_target/include
    ${REPO_ROOT}/lib/sony_remote/include
)

target_compile_options(app PRIVATE -std=c++17 -fpermissive)
```

## prj.conf
```kconfig
CONFIG_ZTEST=y
CONFIG_ZTEST_NEW_API=y
CONFIG_MAIN_STACK_SIZE=4096
CONFIG_LOG=y
CONFIG_CPLUSPLUS=y
CONFIG_LIB_CPLUSPLUS=y
CONFIG_STD_CPP17=y
CONFIG_NEWLIB_LIBC=y
CONFIG_HEAP_MEM_POOL_SIZE=16384
CONFIG_ASSERT=y
CONFIG_SMF=y
CONFIG_SMF_ANCESTOR_SUPPORT=y
CONFIG_ZBUS=y
CONFIG_ZBUS_CHANNEL_NAME=y
CONFIG_ZBUS_OBSERVER_NAME=y
# CONFIG_BT is not set
```

## src/main.cpp
```c
#include <zephyr/kernel.h>
#include <zephyr/ztest.h>

#include "StateMachine.h"

struct state_machine_fixture {
  StepperWithTarget *stepper;
  SonyRemote *remote;
  StateMachine *machine;
  struct k_thread thread_data;
  bool stop_thread;
  bool thread_exited;
};

K_THREAD_STACK_DEFINE(state_machine_thread_stack, 4096);

static void state_machine_thread(void *p1, void *, void *) {
  auto *fixture = static_cast<state_machine_fixture *>(p1);
  while (!fixture->stop_thread) {
    fixture->machine->run_state_machine();
    k_yield();
  }
  fixture->thread_exited = true;
}

static void *state_machine_setup(void) {
  auto *fixture = new state_machine_fixture;
  fixture->stepper = new StepperWithTarget(nullptr, 1, 1);
  fixture->remote = new SonyRemote();
  fixture->machine = new StateMachine(fixture->stepper, fixture->remote);
  fixture->stop_thread = false;
  fixture->thread_exited = false;

  k_thread_create(&fixture->thread_data, state_machine_thread_stack,
                  K_THREAD_STACK_SIZEOF(state_machine_thread_stack),
                  state_machine_thread, fixture, nullptr, nullptr,
                  K_PRIO_PREEMPT(1), 0, K_NO_WAIT);
  return fixture;
}

static void state_machine_teardown(void *data) {
  auto *fixture = static_cast<state_machine_fixture *>(data);
  fixture->stop_thread = true;
  /* Wake the thread if it is waiting on events */
  event_pub(EVENT_STATUS);
  wait_for_condition([&]() { return fixture->thread_exited; }, 500);

  delete fixture->machine;
  delete fixture->remote;
  delete fixture->stepper;
  delete fixture;
}

template <typename Predicate>
static bool wait_for_condition(Predicate predicate, int timeout_ms = 250,
                               int step_ms = 5) {
  int waited = 0;
  while (waited <= timeout_ms) {
    if (predicate()) {
      return true;
    }
    k_msleep(step_ms);
    waited += step_ms;
  }
  return false;
}

static void reset_bounds(state_machine_fixture *fixture, int lower, int upper) {
  event_pub(EVENT_SET_LOWER_BOUND_TO, lower);
  event_pub(EVENT_SET_UPPER_BOUND_TO, upper);
  wait_for_condition([&]() {
    auto status = fixture->machine->get_stack_status();
    return status.lower_bound == lower && status.upper_bound == upper;
  });
}

ZTEST(state_machine_suite, test_go_pct_moves_stepper_within_bounds) {
  auto *fixture = static_cast<state_machine_fixture *>(ztest_get_user_data());
  reset_bounds(fixture, 0, 10000);

  event_pub(EVENT_GO_PCT, 50);
  zassert_true(wait_for_condition([&]() {
                 return fixture->stepper->get_target_position_nm() == 5000;
               }),
               "Stepper did not move to midpoint");
}

ZTEST(state_machine_suite, test_start_stack_with_requested_length) {
  auto *fixture = static_cast<state_machine_fixture *>(ztest_get_user_data());
  reset_bounds(fixture, 0, 4000);

  event_pub(EVENT_SET_WAIT_BEFORE_MS, 0);
  event_pub(EVENT_SET_WAIT_AFTER_MS, 0);
  event_pub(EVENT_START_STACK_WITH_LENGTH, 4);

  zassert_true(wait_for_condition(
                   [&]() {
                     auto status = fixture->machine->get_stack_status();
                     return status.index_in_stack.has_value() &&
                            status.length_of_stack == 4;
                   },
                   500),
               "Stack did not start");

  zassert_true(wait_for_condition(
                   [&]() {
                     return !fixture->machine->get_stack_status()
                                 .index_in_stack.has_value();
                   },
                   2000),
               "Stack did not complete");
}

ZTEST(state_machine_suite, test_go_relative_updates_target) {
  auto *fixture = static_cast<state_machine_fixture *>(ztest_get_user_data());
  reset_bounds(fixture, 0, 1000);
  fixture->stepper->set_target_position_nm(100);

  event_pub(EVENT_GO, 250);
  zassert_true(wait_for_condition([&]() {
                 return fixture->stepper->get_target_position_nm() == 350;
               }),
               "Relative move did not apply");
}

ZTEST_SUITE(state_machine_suite, NULL, state_machine_setup, NULL, NULL,
            state_machine_teardown);
```

## src/fake_stepper_with_target.cpp
```c
#include <stepper_with_target/StepperWithTarget.h>
#include <zephyr/logging/log.h>
#include <zephyr/sys/util.h>

LOG_MODULE_REGISTER(test_stepper_with_target, LOG_LEVEL_INF);

StepperWithTarget::StepperWithTarget(const struct device *dev,
                                     int _pitch_per_rev,
                                     int _pulses_per_rev_mm) {
  stepper_dev = dev;
  pitch_per_rev_nm = _pitch_per_rev * 1000000;
  pulses_per_rev = _pulses_per_rev_mm;
  target_position = 0;
  is_moving = false;
  enabled = true;
}

char *StepperWithTarget::state() {
  static char buffer[96];
  snprintf(buffer, sizeof(buffer), "TestStepper enabled=%d target=%d steps",
           enabled ? 1 : 0, target_position);
  return buffer;
}

void StepperWithTarget::log_state() { LOG_INF("%s", state()); }

int StepperWithTarget::enable() {
  enabled = true;
  return 0;
}

int StepperWithTarget::disable() {
  enabled = false;
  return 0;
}

void StepperWithTarget::start() { enable(); }

void StepperWithTarget::pause() { is_moving = false; }

void StepperWithTarget::wait_and_pause() { is_moving = false; }

int StepperWithTarget::get_position() { return target_position; }

int StepperWithTarget::set_speed(StepperSpeed speed) {
  ARG_UNUSED(speed);
  return 0;
}

void StepperWithTarget::event_callback_wrapper(const struct device *dev,
                                               const enum stepper_event event,
                                               void *user_data) {
  ARG_UNUSED(dev);
  ARG_UNUSED(event);
  ARG_UNUSED(user_data);
}

int32_t StepperWithTarget::go_relative(int32_t dist) {
  target_position += dist;
  return target_position;
}

void StepperWithTarget::set_target_position(int32_t _target_position) {
  target_position = _target_position;
}

int32_t StepperWithTarget::get_target_position() { return target_position; }

int32_t StepperWithTarget::steps_to_nm(int32_t steps) {
  if (pulses_per_rev == 0) {
    return steps;
  }
  int64_t result =
      ((int64_t)steps * (int64_t)pitch_per_rev_nm) / (int64_t)pulses_per_rev;
  return (int32_t)result;
}

int32_t StepperWithTarget::nm_to_steps(int32_t nm) {
  if (pitch_per_rev_nm == 0) {
    return nm;
  }
  int64_t result =
      ((int64_t)nm * (int64_t)pulses_per_rev) / (int64_t)pitch_per_rev_nm;
  return (int32_t)result;
}

int32_t StepperWithTarget::go_relative_nm(int32_t dist) {
  int32_t steps = nm_to_steps(dist);
  return go_relative(steps);
}

void StepperWithTarget::set_target_position_nm(int32_t _target_position) {
  int32_t steps = nm_to_steps(_target_position);
  set_target_position(steps);
}

int32_t StepperWithTarget::get_target_position_nm() {
  int32_t steps = get_target_position();
  return steps_to_nm(steps);
}

bool StepperWithTarget::step_towards_target() {
  is_moving = false;
  return true;
}

bool StepperWithTarget::is_in_target_position() { return true; }

const struct stepper_with_target_status StepperWithTarget::get_status() {
  return {
      .actual_position = get_target_position(),
      .is_moving = is_moving,
      .target_position = target_position,
  };
}

void start_stepper(StepperWithTarget *_started_stepper_ptr) {
  ARG_UNUSED(_started_stepper_ptr);
}
```
