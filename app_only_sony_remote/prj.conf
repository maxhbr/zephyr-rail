## CMakeLists.txt
```
cmake_minimum_required(VERSION 3.20.0)

set(CMAKE_C_FLAGS -lstdc++)
set(CMAKE_CXX_FLAGS -lstdc++)

find_package(Zephyr REQUIRED HINTS $ENV{ZEPHYR_BASE})
project(sony_remote_example)

# Compile options for C++17
zephyr_library_compile_options(-lstdc++ -std=c++17 -fpermissive)

# Add the sony_remote library
add_subdirectory(../lib/sony_remote ${CMAKE_CURRENT_BINARY_DIR}/sony_remote)

target_sources(app PRIVATE src/main.cpp)

# Link the sony_remote library
target_link_libraries(app PRIVATE sony_remote)
```

## west.yml
```
manifest:
  defaults:
    remote: zephyrproject-rtos
  remotes:
    - name: zephyrproject-rtos
      url-base: https://github.com/zephyrproject-rtos
  projects:
    - name: zephyr
      remote: zephyrproject-rtos
      revision: v3.7.0
      clone-depth: 1
      import: true
  self:
    path: .
```

## prj.conf
```kconfig
CONFIG_BT=y
CONFIG_BT_CENTRAL=y
CONFIG_BT_GATT_CLIENT=y
CONFIG_BT_SCAN_NAME_CNT=1

# Enable logging
CONFIG_LOG=y
CONFIG_BT_DEBUG_LOG=y

# Console
CONFIG_CONSOLE=y
CONFIG_UART_CONSOLE=y

# General settings
CONFIG_HEAP_MEM_POOL_SIZE=16384
CONFIG_MAIN_STACK_SIZE=2048
CONFIG_SYSTEM_WORKQUEUE_STACK_SIZE=2048
```

## src/main.cpp
```c
#include "sony_remote/sony_remote.h"
#include <zephyr/bluetooth/bluetooth.h>
#include <zephyr/kernel.h>
#include <zephyr/logging/log.h>

LOG_MODULE_REGISTER(main, LOG_LEVEL_DBG);

int main(void) {
  LOG_INF("Sony Remote Test Application");

  // Initialize Bluetooth
  if (int err = bt_enable(nullptr); err) {
    LOG_ERR("bt_enable failed (%d)", err);
    return err;
  }

  LOG_INF("BLE on. Enable 'Bluetooth Rmt Ctrl' on the Sony camera and pair on "
          "first connect.");

  // Initialize Sony Remote
  SonyRemote remote;
  remote.begin();
  remote.startScan();

  // Simple test loop
  while (true) {
    if (remote.ready()) {
      LOG_INF("Camera connected! Taking a photo...");

      // Take a photo
      remote.focusDown();
      k_msleep(100);
      remote.shutterDown();
      k_msleep(100);
      remote.shutterUp();
      k_msleep(100);
      remote.focusUp();

      LOG_INF("Photo taken!");
      k_sleep(K_SECONDS(5)); // Wait 5 seconds before next photo
    } else {
      LOG_INF("Waiting for camera connection...");
      k_sleep(K_SECONDS(1));
    }
  }

  return 0;
}
```
