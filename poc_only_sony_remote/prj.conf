## CMakeLists.txt
```
# SPDX-License-Identifier: Apache-2.0

cmake_minimum_required(VERSION 3.20.0)

set(CMAKE_C_FLAGS -lstdc++)
set(CMAKE_CXX_FLAGS -lstdc++)

# set(BOARD b_l4s5i_iot01a)
set(BOARD xiao_ble/nrf52840/sense)

find_package(Zephyr REQUIRED HINTS $ENV{ZEPHYR_BASE})
project(poc_sony_remote)

zephyr_library_compile_options(-lstdc++ -std=c++17 -fpermissive)

# Add the sony_remote library
add_subdirectory(../lib/sony_remote ${CMAKE_CURRENT_BINARY_DIR}/sony_remote)

target_sources(app PRIVATE src/main.cpp)

# Link the sony_remote library
target_link_libraries(app PRIVATE sony_remote)
```

## prj.conf
```kconfig
CONFIG_BT=y
CONFIG_BT_CENTRAL=y
CONFIG_BT_GATT_CLIENT=y
CONFIG_BT_DEVICE_NAME="ZephyrRail"

# Enable pairing and bonding
CONFIG_BT_SMP=y
CONFIG_BT_BONDABLE=y
CONFIG_BT_SMP_SC_PAIR_ONLY=y

# # Persist bonds so the camera reconnects automatically
# CONFIG_SETTINGS=y
# CONFIG_BT_SETTINGS=y

# Enable logging
CONFIG_LOG=y
CONFIG_SERIAL=y
CONFIG_LOG_BACKEND_UART=y

# Console
CONFIG_CONSOLE=y
CONFIG_UART_CONSOLE=y

# General settings
CONFIG_HEAP_MEM_POOL_SIZE=16384
CONFIG_MAIN_STACK_SIZE=4096
CONFIG_SYSTEM_WORKQUEUE_STACK_SIZE=4096

# Increase BT stack sizes
CONFIG_BT_RX_STACK_SIZE=2048

# Additional BT settings for stability
CONFIG_BT_BUF_ACL_RX_SIZE=251
CONFIG_BT_BUF_ACL_TX_SIZE=251
CONFIG_BT_L2CAP_TX_MTU=247
CONFIG_BT_BUF_ACL_TX_COUNT=3
CONFIG_BT_BUF_ACL_RX_COUNT=6
```

## src/main.cpp
```c
#include "sony_remote/sony_remote.h"
#include <zephyr/bluetooth/bluetooth.h>
#include <zephyr/kernel.h>
#include <zephyr/logging/log.h>
#ifdef CONFIG_BT_SETTINGS
#include <zephyr/settings/settings.h>
#endif

LOG_MODULE_REGISTER(main, LOG_LEVEL_DBG);

int main(void) {
  LOG_INF("Sony Remote Proof-of-Concept Application");

  // Initialize Bluetooth
  if (int err = bt_enable(nullptr); err) {
    LOG_ERR("bt_enable failed (%d)", err);
    return err;
  }

#ifdef CONFIG_BT_SETTINGS
  // Load Bluetooth settings (bonding info, etc.)
  if (int err = settings_load(); err) {
    LOG_ERR("settings_load failed (%d)", err);
    return err;
  }
#endif

  LOG_INF("BLE on. Enable 'Bluetooth Rmt Ctrl' on the Sony camera and pair on "
          "first connect.");

  // Initialize Sony Remote with specific camera address
  SonyRemote remote("9C:50:D1:AF:76:5F");
  remote.begin();

  // Add a small delay before starting scan
  k_msleep(100);
  remote.startScan();

  k_msleep(100);

  // Simple test loop
  while (true) {
    if (remote.ready()) {
      LOG_INF("Connected to camera, take one picture...");
      remote.shoot();
      remote.end();
      return 0;
    } else {
      LOG_DBG("Waiting for camera connection...");
      k_sleep(K_SECONDS(1));
    }
  }

  return 0;
}
```
