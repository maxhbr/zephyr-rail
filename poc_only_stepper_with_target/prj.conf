## CMakeLists.txt
```
# SPDX-License-Identifier: Apache-2.0

cmake_minimum_required(VERSION 3.20.0)

set(CMAKE_C_FLAGS -lstdc++)
set(CMAKE_CXX_FLAGS -lstdc++)

set(BOARD xiao_nrf54l15/nrf54l15/cpuapp)

# Add DTS bindings path BEFORE find_package(Zephyr)
list(APPEND DTS_ROOT ${CMAKE_CURRENT_SOURCE_DIR}/../lib/stepper_with_target)

find_package(Zephyr REQUIRED HINTS $ENV{ZEPHYR_BASE})
project(poc_stepper_with_target)

# Add stepper_with_target library (includes the driver)
add_subdirectory(../lib/stepper_with_target ${CMAKE_CURRENT_BINARY_DIR}/stepper_with_target)

target_sources(app PRIVATE src/main.cpp)

target_link_libraries(app PRIVATE stepper_with_target)
```

## prj.conf
```kconfig
CONFIG_CPP=y
CONFIG_REQUIRES_FULL_LIBCPP=y
CONFIG_STD_CPP17=y

CONFIG_STEPPER=y
CONFIG_SIMPLE_STEPPER=y
CONFIG_GPIO=y

CONFIG_LOG=y
# CONFIG_ASSERT=y
CONFIG_SHELL=y
CONFIG_UART_CONSOLE=y
CONFIG_SERIAL=y
CONFIG_LOG_BACKEND_UART=y
```

## boards/native_sim.overlay
```dts
/*
 *
 * SPDX-License-Identifier: Apache-2.0
 */

/ {
	stepper_motor: stepper_motor {
		compatible = "ti,drv84xx";
		status = "okay";
		/* Mock pins for native simulation */
		step-gpios = <&gpio0 0 GPIO_ACTIVE_HIGH>;
		dir-gpios = <&gpio0 1 GPIO_ACTIVE_HIGH>;
		en-gpios = <&gpio0 2 GPIO_ACTIVE_LOW>;
		micro-step-res = <16>;
	};
};
```

## boards/nrf5340dk_nrf5340_cpuapp.overlay
```dts
/*
 *
 * SPDX-License-Identifier: Apache-2.0
 */

/ {
	stepper_motor: stepper_motor {
		compatible = "simple-stepper";
		status = "okay";
		/* X-NUCLEO-IHM14A1 pin mapping */
		step-gpios = <&gpio0 4 GPIO_ACTIVE_HIGH>;    /* CN9-4 (D3) - STCK1 step pin */
		dir-gpios = <&gpio0 29 GPIO_ACTIVE_HIGH>;    /* CN9-8 (D7) - DIR1 direction pin */
		en-gpios = <&gpio0 31 GPIO_ACTIVE_LOW>;      /* CN5-1 (D8) - STBY standby pin (active low) */
		micro-step-res = <16>;
	};
};
```

## boards/nrf54l15dk_nrf54l15_cpuapp.overlay
```dts
/*
 * nRF54L15DK overlay
 * SPDX-License-Identifier: Apache-2.0
 */

/ {
	stepper_motor: stepper_motor {
		compatible = "ti,drv84xx";
		status = "okay";
		step-gpios = <&gpio1 5 GPIO_ACTIVE_HIGH>;    /* Step/Clock signal (STCK1) */
		dir-gpios = <&gpio1 7 GPIO_ACTIVE_HIGH>;     /* Direction signal (DIR1) */
		en-gpios = <&gpio1 9 GPIO_ACTIVE_LOW>;       /* Enable/Standby signal (STBY) - active low */
		micro-step-res = <16>;
	};
};
```

## boards/xiao_ble.overlay
```dts
/*
 * XIAO nRF52840 overlay
 * SPDX-License-Identifier: Apache-2.0
 */

/ {
	stepper_motor: stepper_motor {
		compatible = "simple-stepper";
		status = "okay";
		step-gpios = <&gpio0 29 GPIO_ACTIVE_HIGH>;
		dir-gpios = <&gpio0 4 GPIO_ACTIVE_HIGH>;
		en-gpios = <&gpio0 5 GPIO_ACTIVE_LOW>;
		micro-step-res = <16>;
		invert-pins;
	};
};
```

## boards/xiao_nrf54l15_nrf54l15_cpuapp.overlay
```dts
/*
 * XIAO nRF52840 overlay
 * SPDX-License-Identifier: Apache-2.0
 */

/ {
	stepper_motor: stepper_motor {
		compatible = "simple-stepper";
		status = "okay";
		step-gpios = <&gpio1 7 GPIO_ACTIVE_HIGH>;
		dir-gpios = <&gpio1 10 GPIO_ACTIVE_HIGH>;
		en-gpios = <&gpio1 11 GPIO_ACTIVE_LOW>;
		micro-step-res = <16>;
		invert-pins;
	};
};
```

## dts/bindings/stepper/simple-stepper.yaml
```yaml
# SPDX-License-Identifier: Apache-2.0

description: |
  Simple Step/Direction Stepper Motor Driver with Enable Pin
  
  This is a minimal stepper driver for basic step/direction/enable stepper controllers.
  It provides simple control of stepper motors using three GPIO pins:
  - step: pulse signal for stepping
  - dir: direction control (high=positive, low=negative)
  - en: enable pin (active low by default, configurable via GPIO flags)
  
  Example:
    stepper: stepper {
      compatible = "simple-stepper";
      status = "okay";
      step-gpios = <&gpio1 5 GPIO_ACTIVE_HIGH>;
      dir-gpios = <&gpio1 7 GPIO_ACTIVE_HIGH>;
      en-gpios = <&gpio1 9 GPIO_ACTIVE_LOW>;
      micro-step-res = <16>;
    };

compatible: "simple-stepper"

include:
  - name: stepper-controller.yaml
```

## src/main.cpp
```c
#include <zephyr/device.h>
#include <zephyr/drivers/gpio.h>
#include <zephyr/drivers/stepper.h>
#include <zephyr/kernel.h>
#include <zephyr/logging/log.h>

#include "stepper_with_target/StepperWithTarget.h"

LOG_MODULE_REGISTER(main, LOG_LEVEL_DBG);

#define STEPPER_NODE DT_NODELABEL(stepper_motor)
#define LED0_NODE DT_ALIAS(led0)

int main(void) {
  const struct device *stepper_dev = DEVICE_DT_GET(STEPPER_NODE);

  if (!device_is_ready(stepper_dev)) {
    LOG_ERR("Stepper device is not ready");
    return -1;
  }

  LOG_INF("Stepper device is ready");

  // Set up LED
  static const struct gpio_dt_spec led = GPIO_DT_SPEC_GET(LED0_NODE, gpios);
  const struct device *led_dev = nullptr;

  if (gpio_is_ready_dt(&led)) {
    int ret = gpio_pin_configure_dt(&led, GPIO_OUTPUT_INACTIVE);
    if (ret < 0) {
      LOG_ERR("Failed to configure LED: %d", ret);
    } else {
      led_dev = led.port;
      LOG_INF("LED is ready and will be controlled by stepper");
    }
  } else {
    LOG_WRN("LED device is not ready, stepper will run without LED indicator");
  }

  // Create StepperWithTarget instance with LED
  StepperWithTarget stepper(stepper_dev, led_dev);

  // Enable the stepper
  int ret = stepper.enable();
  if (ret < 0) {
    LOG_ERR("Failed to enable stepper: %d", ret);
    return ret;
  }

  // Set step interval to 5ms (5000 microseconds) = 200 steps/second
  // Previous value of 20000000 (20 seconds!) was way too slow
  ret = stepper_set_microstep_interval(stepper_dev,
                                       117188); // ~117 µs , for 10 RPM
  if (ret < 0) {
    LOG_WRN("Failed to set step interval: %d", ret);
    return ret;
  }

  LOG_INF("Testing stepper motor movements with StepperWithTarget...");
  LOG_INF("LED will automatically turn ON when moving and OFF when at target");

  while (1) {
    // Move clockwise (LED will turn ON automatically)
    LOG_INF("Moving 20000 steps clockwise");

    stepper.go_relative(20000);
    stepper.log_state();
    stepper.step_towards_target();

    // Wait for movement to complete (LED will turn OFF automatically)
    stepper.wait_and_pause();

    LOG_INF("Clockwise movement finished, pausing...");
    k_sleep(K_SECONDS(1));

    // Move counter-clockwise (LED will turn ON automatically)
    LOG_INF("Moving 20000 steps counter-clockwise");

    stepper.go_relative(-20000);
    stepper.log_state();
    stepper.step_towards_target();

    // Wait for movement to complete (LED will turn OFF automatically)
    stepper.wait_and_pause();

    LOG_INF("Counter-clockwise movement finished, pausing...");
    k_sleep(K_SECONDS(1));
  }

  return 0;
}
```
